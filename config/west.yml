## config/west.yml
```yaml
manifest:
  remotes:
    - name: zmkfirmware
      url-base: https://github.com/zmkfirmware
    # Additional modules containing boards/shields/custom code can be listed here as well
    # See https://docs.zephyrproject.org/3.2.0/develop/west/manifest.html#projects
    - name: mouse_move_support
      url-base: https://github.com/petejohanson
  projects:
    - name: zmk
      remote: mouse_move_support
      revision: feat/pointers-move-scroll
      import: app/west.yml
  self:
    path: config
```
